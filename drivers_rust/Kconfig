## drivers_rust/Kconfig
```kconfig
# SPDX-License-Identifier: GPL-2.0-only
menuconfig DRIVERS_RUST
	bool "Drivers built in rust"

if DRIVERS_RUST

config I2C_BCM2835
	tristate "I2C_BCM2835"
	help
	  If you say yes to this option, support will be included for the
	  BCM2835 I2C controller.

	  If you don't know what to do here, say N.

	  This support is also available as a module.  If so, the module
	  will be called i2c-bcm2835.

endif # DRIVERS_RUST
```
